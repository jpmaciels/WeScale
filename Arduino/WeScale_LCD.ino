#include <SPI.h>              
#include <Adafruit_GFX.h>                                                      // hardware-specific library
#include <MCUFRIEND_kbv.h>                                                     // hardware-specific library
#include "qrcode.h"
#include <TouchScreen.h>

// #include <SdFat.h>                // SD card & FAT filesystem library
// #include <Adafruit_SPIFlash.h>    // SPI / QSPI flash library
// #include <Adafruit_ImageReader.h> // Image-reading functions

// TFT LCD instance
MCUFRIEND_kbv tft;

// SD card usage
// SdFat                SD;         // SD card filesystem
// Adafruit_ImageReader reader(SD); // Image-reader object, pass in SD filesys
// #define SD_CS   10 // SD card select pin
// #define TFT_CS A3 // TFT select pin
// #define TFT_DC  A2 // TFT display/command pin

// Touchscreen definitions
#define MINPRESSURE 200
#define MAXPRESSURE 1000
const int XP=8,XM=A2,YP=A3,YM=9; //240x400 ID=0x7793
// const int TS_LEFT=903,TS_RT=120,TS_TOP=54,TS_BOT=930;
const int TS_LEFT=120,TS_RT=903,TS_TOP=930,TS_BOT=54;
TouchScreen ts = TouchScreen(XP, YP, XM, YM, 300);

// some principal color definitions
// RGB 565 color picker at https://ee-programming-notepad.blogspot.com/2016/10/16-bit-color-generator-picker.html
#define WHITE       0xFFFF
#define BLACK       0x0000
#define RED         0xF800
#define GREEN       0x0f0f
#define WE_SCALE_1  0x5bd9
#define WE_SCALE_2  0x212a

// 'Logo', 36x29px
const unsigned char logo [] PROGMEM = {
  0x4a, 0x00, 0xc0, 0x02, 0x00, 0x4a, 0x01, 0xa0, 0x02, 0x00, 0x4a, 0x71, 0x26, 0x32, 0xe0, 0x4a, 
  0x90, 0x8b, 0x0a, 0xa0, 0x4a, 0xd0, 0x48, 0x0a, 0xa0, 0x4a, 0xe0, 0x28, 0x3a, 0xe0, 0x4a, 0x81, 
  0x28, 0x4a, 0x80, 0x4a, 0x91, 0x2b, 0x4a, 0xa0, 0x7e, 0x71, 0xc6, 0x32, 0xe0, 0x00, 0x00, 0x00, 
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  0x0c, 0x00, 0x03, 0xff, 0xff, 0xfc, 0x00, 0x00, 0xc0, 0x00, 0x30, 0x00, 0x00, 0xc0, 0x00, 0x30, 
  0x00
};

// 'Big Logo', 116x92px
const unsigned char big_logo [] PROGMEM = {
  0x00, 0x00, 0x00, 0x00, 0x00, 0x00, 0x00, 0x00, 0x00, 0x00, 0x00, 0x00, 0x80, 0x00, 0x00, 0x08, 
  0x08, 0x04, 0x00, 0x00, 0x00, 0x07, 0x80, 0x00, 0x00, 0x00, 0x01, 0xc0, 0x00, 0x00, 0x1c, 0x1c, 
  0x0e, 0x00, 0x00, 0x00, 0x1f, 0xe0, 0x00, 0x00, 0x00, 0x01, 0xc0, 0x00, 0x00, 0x1c, 0x1c, 0x0e, 
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  0x80, 0x00, 0x00, 0x00
};

// QR code options
int qrPixel = 4;
int qrSize = 45;
int position_x = 30;
int position_y = 140;
int border = 5;
int rectpos_x = position_x - border;
int rectpos_y = position_y - border;

String fruit, weightStr, priceStr;
float weight, price, total;

// state machine states
enum states {
  none,
  inicio,
  pesando,
  pesado,
  finalizado
};

states priorstate, state;

// String for serial read
String received_message="";

void setup() {
  Serial.begin(9600);
  while (!Serial) {
    ; // wait for serial port to connect. Needed for native USB
  }
  received_message.reserve(200);
  initializeDisplay();
  drawLogo();
  drawBotoes();
  priorstate = none;
  state = inicio;
}


void loop(void){
  switch (state) {
    case inicio:
      inicio_state();
      break;
    case pesando:
      pesando_state();
      break;
    case pesado:
      pesado_state();
      break;
    case finalizado:
      finalizado_state();
      break;
  }
}

// /*
void inicio_state() {
  // Tarefas de entrada do estado
  if(state != priorstate){
    priorstate = state;

    //coisas da inicializaï¿½ï¿½o do estado inicial: ...
    tft.fillScreen(WHITE);
    drawBigLogo();

    // Buttons
    tft.fillRoundRect(5, 345, 230, 50, 4, GREEN);

    tft.setTextColor(WHITE);
    tft.setTextSize(2);
    tft.setCursor(220, 8);
    tft.print("X");

    tft.setCursor(80, 362);
    tft.print("Iniciar");

  }

  //tarefas do estado inicial: ...

  // Check for state transitions
  int button = getTouchButton();
  if(button == 1 || button == 2){
    state = pesando;
  }

  // Tarefas de saï¿½da do estado
  if (state != priorstate) {
    tft.fillScreen(WHITE);
  }
}

void pesando_state(){
  // Tarefas de entrada do estado
  if(state != priorstate){
    sendNumberToPi(10);
    priorstate = state;

    //coisas da inicializaï¿½ï¿½o do estado pesando: ...
    // Serial.write()
    drawLogo();
    drawLoading();
    //drawBotoes();
  }

  //tarefas do estado pesando: ...
  

  // Check for state transitions
  while(!Serial.available()){
    ;
  }
  received_message = Serial.readStringUntil('\n');  //read until timeout
  received_message.trim();
  
  if(received_message){
//    Serial.print("Recebi: ");
//    Serial.println(received_message);
    parseInput(received_message);
    state = pesado;
  }
  
  // if("cancelar"){
  //   state = inicio;
  // }

  // Tarefas de saï¿½da do estado
  if (state != priorstate) {
    tft.fillScreen(WHITE);
  }
}

void pesado_state(){
  // Tarefas de entrada do estado
  if(state != priorstate){
    priorstate = state;
    
    //coisas da inicializaï¿½ï¿½o do estado pesado: ...
    drawLogo();
    drawBotoes();
    drawText();
  }

  //tarefas do estado pesado: ...

  // Check for state transitions

  int button = getTouchButton();
  if(button == 1){
    state = pesando;
  }
  if(button == 2){
    state = finalizado;
  }
  if(button == 3){
    state = inicio;
  }

  // Tarefas de saï¿½da do estado
  if (state != priorstate) {
    tft.fillScreen(WHITE);
  }
}

void finalizado_state(){
  // Tarefas de entrada do estado
  if(state != priorstate){
    priorstate = state;
    clearSerialBuffer();
    sendNumberToPi(20);
    while(!Serial.available()){
    ;
    }
    received_message = Serial.readStringUntil('\n');  //read until timeout
    received_message.trim();
    //coisas da inicializaï¿½ï¿½o do estado finalizado: ...
    drawFinalizado();
    displayQRcode(received_message.c_str());
    drawFinalizadoBotao();
  }

  //tarefas do estado finalizado: ...

  // Check for state transitions
  int button = getTouchButton();
  if(button == 1){
    state = inicio;
  }
  if(button == 2){
    state = inicio;
  }
  if(button == 3){
    state = inicio;
  }

  // Tarefas de saï¿½da do estado
  if (state != priorstate) {
    tft.fillScreen(WHITE);
  }
}
//*/

int getTouchButton(){

  int pixel_x, pixel_y;
  TSPoint p = ts.getPoint();
  pinMode(YP, OUTPUT);      //restore shared pins
  pinMode(XM, OUTPUT);
  digitalWrite(YP, HIGH);   //because TFT control pins
  digitalWrite(XM, HIGH);
  bool pressed = (p.z > MINPRESSURE && p.z < MAXPRESSURE);
  if (pressed) {
      pixel_x = map(p.x, TS_LEFT, TS_RT, 0, tft.width()); //.kbv makes sense to me
      pixel_y = map(p.y, TS_TOP, TS_BOT, 0, tft.height());

      // Left button 
      if (pixel_x >= 5 && pixel_x <= 120 && pixel_y >= 345 && pixel_y <= 395) {
        return 1;
      }
      // Right button 
      else if (pixel_x >= 121 && pixel_x <= 235 && pixel_y >= 345 && pixel_y <= 395){
        return 2;
      }
      // Cancel button 
      else if (pixel_x >= 215 && pixel_x <= 235 && pixel_y >= 5 && pixel_y <= 25){
        return 3;
      }
  }

  return -1;
}

void drawBotoes(){
  tft.fillRoundRect(5, 345, 113, 50, 4, WE_SCALE_2);
  tft.fillRoundRect(122, 345, 113, 50, 4, WE_SCALE_1);
  tft.fillRoundRect(215, 5, 20, 20, 4, RED);
  
  tft.setTextColor(WHITE);
  tft.setTextSize(2);
  tft.setCursor(220, 8);
  tft.print("X");

  tft.setTextColor(WHITE);
  tft.setTextSize(2);
  tft.setCursor(55, 362);
  tft.print("+");

  tft.setTextColor(WHITE);
  tft.setTextSize(2);
  tft.setCursor(126, 362);
  tft.print("Finalizar");

}

void drawText(){
  tft.setTextColor(BLACK);
  tft.setTextSize(4);
  tft.setCursor(25, 47);
  tft.print(fruit);
  tft.setTextSize(2);
  tft.setCursor(25, 97);
  tft.print(weight);
  tft.print("kg");
  tft.setCursor(120, 97);
  tft.print("R$");
  tft.print(total);
}

void drawLogo(){
  tft.drawBitmap(5,5,logo,36,29,WE_SCALE_2);
}

void drawBigLogo(){
  tft.drawBitmap(62,135,big_logo,116,92,WE_SCALE_2);
}

void drawLoading(){
  tft.setTextColor(WE_SCALE_1);
  tft.setCursor(33, 150);
  tft.setTextSize(3);
  tft.println("Pesando...");
  tft.setCursor(33, 175);
  tft.setTextSize(1);
  tft.print("Aguarde alguns instantes ");
  tft.write(0x02);
  tft.println(); 
}

void drawFinalizado(){
  tft.setTextColor(WE_SCALE_1);
  tft.setCursor(25, 47);
  tft.setTextSize(3);
  tft.print("Pronto!");
  tft.write(0x02);
  tft.println(); 
  tft.setCursor(25, 77);
  tft.setTextSize(1);
  tft.println("Para efetuar o pagamento, leia");
  tft.setCursor(25, 86);
  tft.println("o QR-code abaixo no app WeScale!"); 
}

void drawFinalizadoBotao(){
  tft.fillRoundRect(5, 345, 230, 50, 4, RED);

  tft.setTextColor(WHITE);
  tft.setTextSize(2);
  tft.setCursor(56, 362);
  tft.print("Nova compra");
}

void initializeDisplay(){
  uint16_t ID;
  ID = tft.readID();                                                             // valid for Uno shields  

  tft.reset();
  tft.begin (ID);                                                                // initialize SPI bus 
  tft.setRotation (2);                                                           // landscape                                          
  tft.fillScreen (WHITE);
}

void displayQRcode(const char* text){

  QRCode qrcode;
  uint8_t qrcodeData[qrcode_getBufferSize(7)];
  qrcode_initText(&qrcode, qrcodeData, 7, 0, text);

  tft.fillRoundRect(rectpos_x, rectpos_y, qrSize*qrPixel + border*2, qrSize*qrPixel + border*2, 4, WE_SCALE_2);
  tft.fillRoundRect(rectpos_x+3, rectpos_y+3, qrSize*qrPixel + (border-3)*2, qrSize*qrPixel + (border-3)*2, 4, WHITE);

  for (uint8_t y = 0; y < qrSize; y++) {
    for (uint8_t x = 0; x < qrSize; x++) {
      if(qrcode_getModule(&qrcode,x,y)){
        tft.fillRect(position_x + x*qrPixel, position_y + y*qrPixel, qrPixel, qrPixel, WE_SCALE_2);
      }
    }
  }
}

// Function to parse the input string
void parseInput(String input) {
  int firstUnderscoreIndex = input.indexOf('_');
  int secondUnderscoreIndex = input.indexOf('_', firstUnderscoreIndex + 1);

  fruit = input.substring(0, firstUnderscoreIndex);
  weightStr = input.substring(firstUnderscoreIndex + 1, secondUnderscoreIndex);
  priceStr = input.substring(secondUnderscoreIndex + 1);

  weight = weightStr.toFloat();
  price = priceStr.toFloat();
  total = weight*price;

  // Print the results
//  Serial.print("fruit: ");
//  Serial.println(fruit);
//  Serial.print("weight: ");
//  Serial.println(weight);
//  Serial.print("price: ");
//  Serial.println(price);
//  Serial.print("total: ");
//  Serial.println(total);
}

void sendNumberToPi(int n){
  Serial.print(n);
  Serial.print("\n");
}

void clearSerialBuffer() {
  while (Serial.available() > 0) {
    Serial.read();
  }
}
